## config/boards/shields/dactyl/Kconfig.defconfig
```kconfig
if SHIELD_DACTYL_RIGHT

config ZMK_KEYBOARD_NAME
	default "Dactyl"

config ZMK_SPLIT_BLE_ROLE_CENTRAL
	default y

# Set this to the number of peripherals your dongle will have.
# For a unibody, this would be 1. If you have left and right halves, set it to 2, etc.
config ZMK_SPLIT_BLE_CENTRAL_PERIPHERALS
	int
    default 2

# Set this to ZMK_SPLIT_BLE_CENTRAL_PERIPHERALS + your desired number of BT profiles (default is 5)
config BT_MAX_CONN
	int
    default 6

# Set this to the same number as BT_MAX_CONN
config BT_MAX_PAIRED
	int
    default 6

endif

if SHIELD_DACTYL_DONGLE

config ZMK_KEYBOARD_NAME
	default "Dactyl Dongle"

config ZMK_SPLIT_ROLE_CENTRAL
	default y

config ZMK_SPLIT
	default y

config ZMK_SPLIT_BLE_CENTRAL_PERIPHERALS
	int
    default 2

config BT_MAX_CONN
	int
    default 6

# Set this to the same number as BT_MAX_CONN
config BT_MAX_PAIRED
	int
    default 6

endif
```

## config/boards/shields/dactyl/Kconfig.shield
```kconfig
config SHIELD_DACTYL_LEFT
    def_bool $(shields_list_contains,dactyl_left)

config SHIELD_DACTYL_RIGHT
    def_bool $(shields_list_contains,dactyl_right)

# No whitespace after the comma or in the keyboard name!
config SHIELD_MY_KEYBOARD_DONGLE
    def_bool $(shields_list_contains,my_keyboard_dongle)
```

## config/west.yml
```yaml
---
manifest:
  remotes:
    - name: zmkfirmware
      url-base: https://github.com/zmkfirmware
    - name: DoctorWangWang
      url-base: https://github.com/DoctorWangWang
    - name: carrefinho
      url-base: https://github.com/carrefinho
  projects:
    - name: zmk
      remote: zmkfirmware
      revision: v0.3
      import: app/west.yml
    - name: prospector-zmk-module
      remote: carrefinho
      revision: main
    - name: zmk-pmw3610-driver
      remote: DoctorWangWang
      revision: main
  self:
    path: config
```
